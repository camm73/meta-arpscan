## conf/layer.conf
```bitbake
# We have a conf and classes directory, add to BBPATH
BBPATH .= ":${LAYERDIR}"

# We have recipes-* directories, add to BBFILES
BBFILES += "${LAYERDIR}/recipes-*/*/*.bb \
            ${LAYERDIR}/recipes-*/*/*.bbappend"

BBFILE_COLLECTIONS += "meta-arpscan"
BBFILE_PATTERN_meta-arpscan = "^${LAYERDIR}/"
BBFILE_PRIORITY_meta-arpscan = "6"

LAYERDEPENDS_meta-arpscan = "core"
LAYERSERIES_COMPAT_meta-arpscan = "dunfell gatesgarth hardknott"
```
